## drivers/net/wireless/realtek/rtl88x2bu/Kconfig
```kconfig
config RTL88X2BU
	tristate "Realtek RTL88x2BU USB WiFi support"
	depends on USB && WLAN && CFG80211
	select WIRELESS_EXT
	help
	  Say Y here if you want to use the Realtek RTL88x2BU chipset
	  USB WiFi adapter.

	  If you compile this driver as a module, it will be called
	  rtl88x2bu.ko
```
